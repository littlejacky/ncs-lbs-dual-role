## CMakeLists.txt
```
#
# Copyright (c) 2018 Nordic Semiconductor
#
# SPDX-License-Identifier: LicenseRef-Nordic-5-Clause
#
cmake_minimum_required(VERSION 3.20.0)

find_package(Zephyr REQUIRED HINTS $ENV{ZEPHYR_BASE})
project(lbs)

# NORDIC SDK APP START
target_sources(app PRIVATE
  src/main.c
  src/nrf54l15_power_mgr.c
)

# NORDIC SDK APP END
target_include_directories(app PRIVATE include)
```

## prj.conf
```kconfig
# 基本蓝牙功能
CONFIG_BT=y
CONFIG_BT_PERIPHERAL=y
CONFIG_BT_CENTRAL=y
CONFIG_BT_DEVICE_NAME="Nordic_LBS"
CONFIG_BT_DEVICE_APPEARANCE=832
CONFIG_BT_MAX_CONN=2
CONFIG_BT_MAX_PAIRED=2

# LBS, HRS 以及底层蓝牙服务
CONFIG_BT_LBS=y
CONFIG_BT_LBS_POLL_BUTTON=y
CONFIG_BT_HRS=y
CONFIG_BT_HRS_CLIENT=y
CONFIG_BT_GATT_CLIENT=y
CONFIG_BT_GATT_DM=y
CONFIG_BT_SCAN=y
CONFIG_BT_SCAN_FILTER_ENABLE=y
CONFIG_BT_SCAN_UUID_CNT=1

# DK板及LED/按钮
CONFIG_DK_LIBRARY=y

# 持久化、系统设置
CONFIG_BT_SETTINGS=y
CONFIG_SETTINGS=y
CONFIG_FLASH=y
CONFIG_FLASH_PAGE_LAYOUT=y
CONFIG_FLASH_MAP=y

# 栈、堆
CONFIG_SYSTEM_WORKQUEUE_STACK_SIZE=2048
CONFIG_HEAP_MEM_POOL_SIZE=1024

# 安全与RSSI
CONFIG_BT_SMP=y
# 连接 RSSI 测量支持
CONFIG_BT_CTLR_CONN_RSSI=y
CONFIG_BT_CTLR_ADVANCED_FEATURES=y
CONFIG_BT_CTLR_TX_PWR_DYNAMIC_CONTROL=y

# L2CAP和扩展支持
CONFIG_BT_L2CAP_TX_BUF_COUNT=8

# 调试—可选，开发阶段可开
#CONFIG_BT_GATT_DM_DATA_PRINT=y
#CONFIG_NET_BUF_LOG=y

# 需要扩展广播
CONFIG_BT_EXT_ADV=y
```

## include/nrf54l15_power_mgr.h
```c
// nrf54l15_power_mgr.h
#ifndef NRF54L15_POWER_MGR_H
#define NRF54L15_POWER_MGR_H
#include "ring_types.h"
#include <stdint.h>
#include <zephyr/bluetooth/conn.h>

typedef enum {
    POWER_MODE_ACTIVE,
    POWER_MODE_IDLE,
    POWER_MODE_SLEEP,
    POWER_MODE_DEEP_SLEEP
} power_mode_t;

int init_nrf54l15_power_optimization(void);
// 主循环周期性调用，有需要时主动唤醒
void rssi_update_internal(void);
// 用户活跃定时调用（按钮/远程/数据包/连接建立等）
void on_user_activity(void);
// 新连接建立时
void on_connection_established(struct bt_conn *conn);
// 连接丢失时
void on_connection_lost(void);
// 电池和统计
uint8_t get_battery_level(void);
power_mode_t get_current_power_mode(void);
void print_power_statistics(void);

#endif
```

## include/ring_types.h
```c
// ring_types.h
#ifndef RING_TYPES_H
#define RING_TYPES_H

#include <zephyr/bluetooth/conn.h>
#include <stdbool.h>
#include <stdint.h>

#define RSSI_HISTORY_SIZE 5

typedef enum {
    DISTANCE_UNKNOWN,
    DISTANCE_VERY_CLOSE,
    DISTANCE_CLOSE,
    DISTANCE_MEDIUM,
    DISTANCE_FAR,
    DISTANCE_VERY_FAR
} distance_level_t;

struct rssi_filter {
    int8_t history[RSSI_HISTORY_SIZE];
    uint8_t index;
    bool full;
};

struct ring_connection {
    struct bt_conn *conn;
    bool hrs_ready;
    bool lbs_ready;
    struct rssi_filter rssi_filter;
    int8_t current_rssi;
    distance_level_t distance;
    uint32_t last_rssi_update;
    uint16_t last_hr_value;
    uint32_t connection_time;
};

// 声明全局连接对象
extern struct ring_connection central_ring;
extern struct ring_connection peripheral_ring;

#endif // RING_TYPES_H
```

## src/nrf54l15_power_mgr.c
```c
// nrf54l15_power_mgr.c -- nRF54L15专用功耗优化模块
#include "nrf54l15_power_mgr.h"
#include <zephyr/bluetooth/conn.h>
#include <zephyr/kernel.h>
#include <zephyr/sys/printk.h>
#include <zephyr/pm/pm.h>

// 连接参数
#define CONN_PARAM_ACTIVE_MIN        6
#define CONN_PARAM_ACTIVE_MAX        12
#define CONN_PARAM_IDLE_MIN          40
#define CONN_PARAM_IDLE_MAX          60
#define CONN_PARAM_SLEEP_MIN         80
#define CONN_PARAM_SLEEP_MAX         120
#define CONN_PARAM_DEEP_SLEEP_MIN    240
#define CONN_PARAM_DEEP_SLEEP_MAX    320

#define RSSI_INTERVAL_ACTIVE         3000
#define RSSI_INTERVAL_IDLE           8000
#define RSSI_INTERVAL_SLEEP          20000
#define RSSI_INTERVAL_DEEP_SLEEP     0

#define STATUS_INTERVAL_ACTIVE       10000
#define STATUS_INTERVAL_SLEEP        30000

#define IDLE_THRESHOLD_MS            5000
#define SLEEP_THRESHOLD_MS           30000
#define DEEP_SLEEP_THRESHOLD_MS      120000

struct power_manager {
    power_mode_t current_mode;
    uint32_t last_activity_time;
    uint8_t battery_level;
    bool ultra_low_power;
    uint32_t mode_change_time;
    uint32_t total_active_time;
    uint32_t total_sleep_time;
};

static struct power_manager power_mgr = {
    .current_mode = POWER_MODE_ACTIVE,
    .battery_level = 100,
    .ultra_low_power = false
};

extern struct ring_connection central_ring, peripheral_ring;

static int adjust_connection_params(struct bt_conn *conn, power_mode_t mode) {
    if (!conn) return -EINVAL;
    struct bt_le_conn_param param = {0};
    switch (mode) {
    case POWER_MODE_ACTIVE:
        param.interval_min = CONN_PARAM_ACTIVE_MIN;
        param.interval_max = CONN_PARAM_ACTIVE_MAX;
        param.latency = 0;
        param.timeout = 400;
        break;
    case POWER_MODE_IDLE:
        param.interval_min = CONN_PARAM_IDLE_MIN;
        param.interval_max = CONN_PARAM_IDLE_MAX;
        param.latency = 1;
        param.timeout = 600;
        break;
    case POWER_MODE_SLEEP:
        param.interval_min = CONN_PARAM_SLEEP_MIN;
        param.interval_max = CONN_PARAM_SLEEP_MAX;
        param.latency = 4;
        param.timeout = 800;
        break;
    case POWER_MODE_DEEP_SLEEP:
        param.interval_min = CONN_PARAM_DEEP_SLEEP_MIN;
        param.interval_max = CONN_PARAM_DEEP_SLEEP_MAX;
        param.latency = 10;
        param.timeout = 1200;
        break;
    }
    printk("Adjusting conn params: interval %d-%d, latency %d\n", 
           param.interval_min, param.interval_max, param.latency);
    return bt_conn_le_param_update(conn, &param);
}

static void set_power_mode(power_mode_t new_mode) {
    if (new_mode == power_mgr.current_mode) return;
    uint32_t now = k_uptime_get_32();
    uint32_t duration = now - power_mgr.mode_change_time;
    if (power_mgr.current_mode == POWER_MODE_ACTIVE)
        power_mgr.total_active_time += duration;
    else
        power_mgr.total_sleep_time += duration;
    printk("Power mode: %d->%d (was %ums)\n", power_mgr.current_mode, new_mode, duration);
    power_mgr.current_mode = new_mode;
    power_mgr.mode_change_time = now;
    if (central_ring.conn)
        adjust_connection_params(central_ring.conn, new_mode);
    if (peripheral_ring.conn)
        adjust_connection_params(peripheral_ring.conn, new_mode);
}

void on_user_activity(void) {
    power_mgr.last_activity_time = k_uptime_get_32();
    if (power_mgr.current_mode != POWER_MODE_ACTIVE) {
        set_power_mode(POWER_MODE_ACTIVE);
    }
}

void on_connection_established(struct bt_conn *conn) {
    on_user_activity();
    adjust_connection_params(conn, POWER_MODE_ACTIVE);
}

void on_connection_lost(void) {
    set_power_mode(POWER_MODE_SLEEP);
}

static void update_power_mode(void) {
    uint32_t now = k_uptime_get_32();
    uint32_t idle_time = now - power_mgr.last_activity_time;
    static uint32_t last_battery_update = 0;
    if (now - last_battery_update > 60000) {
        uint8_t drain_rate = 1;
        switch (power_mgr.current_mode) {
        case POWER_MODE_ACTIVE:      drain_rate = 2; break;
        case POWER_MODE_IDLE:        drain_rate = 1; break;
        case POWER_MODE_SLEEP:       drain_rate = 0; break;
        case POWER_MODE_DEEP_SLEEP:  drain_rate = 0; break;
        }
        static uint8_t drain_counter = 0;
        drain_counter += drain_rate;
        if (drain_counter >= 2) {
            power_mgr.battery_level = (power_mgr.battery_level > 0) ? power_mgr.battery_level - 1 : 0;
            drain_counter = 0;
        }
        last_battery_update = now;
        if (power_mgr.battery_level <= 15 && !power_mgr.ultra_low_power) {
            power_mgr.ultra_low_power = true;
            set_power_mode(POWER_MODE_DEEP_SLEEP);
            printk("Ultra low power mode: %d%%\n", power_mgr.battery_level);
            return;
        }
    }
    if (power_mgr.ultra_low_power) return;
    power_mode_t target_mode = power_mgr.current_mode;
    if (idle_time > DEEP_SLEEP_THRESHOLD_MS)
        target_mode = POWER_MODE_DEEP_SLEEP;
    else if (idle_time > SLEEP_THRESHOLD_MS)
        target_mode = POWER_MODE_SLEEP;
    else if (idle_time > IDLE_THRESHOLD_MS)
        target_mode = POWER_MODE_IDLE;
    else
        target_mode = POWER_MODE_ACTIVE;
    if (target_mode != power_mgr.current_mode)
        set_power_mode(target_mode);
}

static uint32_t get_rssi_update_interval(void) {
    switch (power_mgr.current_mode) {
    case POWER_MODE_ACTIVE:      return RSSI_INTERVAL_ACTIVE;
    case POWER_MODE_IDLE:        return RSSI_INTERVAL_IDLE;
    case POWER_MODE_SLEEP:       return RSSI_INTERVAL_SLEEP;
    case POWER_MODE_DEEP_SLEEP:  return RSSI_INTERVAL_DEEP_SLEEP;
    default:                     return RSSI_INTERVAL_ACTIVE;
    }
}
static bool should_update_rssi(void) {
    return (power_mgr.current_mode != POWER_MODE_DEEP_SLEEP);
}

static struct k_work_delayable unified_work;

void rssi_update_internal(void); // 由主文件实现

static void unified_periodic_work_handler(struct k_work *work) {
    update_power_mode();
    if (should_update_rssi()) {
        rssi_update_internal();
    }
    uint32_t next_interval = get_rssi_update_interval();
    if (next_interval > 0)
        k_work_schedule(&unified_work, K_MSEC(next_interval));
}

static void enable_advanced_power_features(void) {
#ifdef CONFIG_SOC_DCDC_NRF54L15
    printk("DCDC converter enabled\n");
#endif
#ifdef CONFIG_CLOCK_CONTROL_NRF_K32SRC_XTAL
    printk("32kHz XTAL configured for low power\n");
#endif
#ifdef CONFIG_PM
    pm_constraint_set(PM_STATE_SUSPEND_TO_IDLE);
    printk("Power management constraints set\n");
#endif
}

int init_nrf54l15_power_optimization(void) {
    printk("Initializing nRF54L15 power optimization...\n");
    power_mgr.last_activity_time = k_uptime_get_32();
    power_mgr.mode_change_time = k_uptime_get_32();
    enable_advanced_power_features();
    k_work_init_delayable(&unified_work, unified_periodic_work_handler);
    k_work_schedule(&unified_work, K_MSEC(RSSI_INTERVAL_ACTIVE));
    printk("Power optimization ready. Battery: %d%%\n", power_mgr.battery_level);
    return 0;
}

uint8_t get_battery_level(void) {
    return power_mgr.battery_level;
}
power_mode_t get_current_power_mode(void) {
    return power_mgr.current_mode;
}
void print_power_statistics(void) {
    uint32_t total_time = power_mgr.total_active_time + power_mgr.total_sleep_time;
    if (total_time == 0) return;
    uint32_t active_percentage = (power_mgr.total_active_time * 100) / total_time;
    uint32_t sleep_percentage = 100 - active_percentage;
    printk("Power Stats: Active %u%%, Sleep %u%%\n", active_percentage, sleep_percentage);
    printk("Estimated battery life improvement: %ux\n", sleep_percentage > 50 ? (sleep_percentage / 20) + 1 : 1);
}
```

## src/nrf54l15_power_mgr.h
```c
#ifndef NRF54L15_POWER_MGR_H
#define NRF54L15_POWER_MGR_H
#include "ring_types.h"
#include <stdint.h>
#include <zephyr/bluetooth/conn.h>

typedef enum {
    POWER_MODE_ACTIVE,
    POWER_MODE_IDLE,
    POWER_MODE_SLEEP,
    POWER_MODE_DEEP_SLEEP
} power_mode_t;

int init_nrf54l15_power_optimization(void);
// 主循环周期性调用，有需要时主动唤醒
void rssi_update_internal(void);
// 用户活跃定时调用（按钮/远程/数据包/连接建立等）
void on_user_activity(void);
// 新连接建立时
void on_connection_established(struct bt_conn *conn);
// 连接丢失时
void on_connection_lost(void);
// 电池和统计
uint8_t get_battery_level(void);
power_mode_t get_current_power_mode(void);
void print_power_statistics(void);

#endif
```

## src/ring_types.h
```c
#ifndef RING_TYPES_H
#define RING_TYPES_H

#include <zephyr/bluetooth/conn.h>
#include <stdbool.h>
#include <stdint.h>

#define RSSI_HISTORY_SIZE 5

typedef enum {
    DISTANCE_UNKNOWN,
    DISTANCE_VERY_CLOSE,
    DISTANCE_CLOSE,
    DISTANCE_MEDIUM,
    DISTANCE_FAR,
    DISTANCE_VERY_FAR
} distance_level_t;

struct rssi_filter {
    int8_t history[RSSI_HISTORY_SIZE];
    uint8_t index;
    bool full;
};

struct ring_connection {
    struct bt_conn *conn;
    bool hrs_ready;
    bool lbs_ready;
    struct rssi_filter rssi_filter;
    int8_t current_rssi;
    distance_level_t distance;
    uint32_t last_rssi_update;
    uint16_t last_hr_value;
    uint32_t connection_time;
};

// 声明全局连接对象
extern struct ring_connection central_ring;
extern struct ring_connection peripheral_ring;

#endif // RING_TYPES_H
```
